## boards/arm/minew_ms151f7/Kconfig.board
```kconfig
# Copyright (c) 2022 Nordic Semiconductor ASA
# SPDX-License-Identifier: Apache-2.0

config BOARD_MINEW_MS151F7
	bool "minew_ms151f7"
	depends on SOC_NRF52833_QIAA
```

## boards/arm/minew_ms151f7/Kconfig.defconfig
```kconfig
# Copyright (c) 2022 Nordic Semiconductor ASA
# SPDX-License-Identifier: Apache-2.0

if BOARD_MINEW_MS151F7

config BOARD
	default "minew_ms151f7"

config BT_CTLR
   default BT

endif
```

## boards/arm/minew_ms151f7/minew_ms151f7_defconfig
```kconfig
# Copyright (c) 2022 Nordic Semiconductor ASA
# SPDX-License-Identifier: Apache-2.0

CONFIG_SOC_SERIES_NRF52X=y
CONFIG_SOC_NRF52833_QIAA=y
CONFIG_BOARD_MINEW_MS151F7=y

# Enable MPU
CONFIG_ARM_MPU=y

# Enable hardware stack protection
CONFIG_HW_STACK_PROTECTION=y

CONFIG_DW3000=y
CONFIG_SPI=y
CONFIG_GPIO=y
```
